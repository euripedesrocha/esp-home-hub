## components/hub_connection/Kconfig.projbuild
```kconfig
menu "Hub connection"

    config HUB_WIFI_SSID
        string "Wi-Fi SSID"
        default ""
        help
            SSID of the access point the station joins at boot.

    config HUB_WIFI_PASSWORD
        string "Wi-Fi password"
        default ""
        help
            Password for HUB_WIFI_SSID. Leave empty for an open network.

endmenu
```

## components/hub_mqtt/Kconfig
```kconfig
menu "Hub MQTT"

config HUB_MQTT_PORT
    int "Broker listener port"
    range 1 65535
    default 1883

config HUB_MQTT_TASK_STACK_SIZE
    int "Broker task stack size"
    range 2048 65536
    default 8192

endmenu
```

## examples/thread_client/sdkconfig.defaults
```kconfig
CONFIG_IDF_TARGET="esp32h2"
CONFIG_ESPTOOLPY_FLASHSIZE_4MB=y

CONFIG_PARTITION_TABLE_CUSTOM=y
CONFIG_PARTITION_TABLE_CUSTOM_FILENAME="partitions.csv"

CONFIG_OPENTHREAD_ENABLED=y
CONFIG_OPENTHREAD_BORDER_ROUTER=n
CONFIG_OPENTHREAD_RADIO_NATIVE=y
CONFIG_OPENTHREAD_MTD=y
CONFIG_OPENTHREAD_TASK_SIZE=8192
CONFIG_OPENTHREAD_CONSOLE_ENABLE=y
CONFIG_OPENTHREAD_CLI=y
CONFIG_OPENTHREAD_NETWORK_NAME="ESPHomeHub"
CONFIG_OPENTHREAD_NETWORK_CHANNEL=25
CONFIG_OPENTHREAD_NETWORK_PANID=0x1234
CONFIG_OPENTHREAD_NETWORK_EXTPANID="dead00beef00cafe"
CONFIG_OPENTHREAD_NETWORK_MASTERKEY="00112233445566778899aabbccddeeff"
CONFIG_OPENTHREAD_NETWORK_PSKC="104810e2315100afd6bc9215a6bfac53"

CONFIG_ESP_CONSOLE_USB_SERIAL_JTAG=y
CONFIG_ESP_MAIN_TASK_STACK_SIZE=6144
```

## sdkconfig.defaults
```kconfig
CONFIG_IDF_TARGET="esp32s31"
CONFIG_ESPTOOLPY_FLASHSIZE_16MB=y

CONFIG_ETH_ENABLED=y
CONFIG_ETH_USE_ESP32_EMAC=y

CONFIG_PARTITION_TABLE_CUSTOM=y
CONFIG_PARTITION_TABLE_CUSTOM_FILENAME="partitions.csv"

CONFIG_COMPILER_CXX_EXCEPTIONS=y
CONFIG_COMPILER_CXX_EXCEPTIONS_EMG_POOL_SIZE=1024

CONFIG_OPENTHREAD_ENABLED=y
CONFIG_OPENTHREAD_BORDER_ROUTER=n
CONFIG_OPENTHREAD_RADIO_NATIVE=y
CONFIG_OPENTHREAD_TASK_SIZE=8192
CONFIG_OPENTHREAD_CONSOLE_ENABLE=n
CONFIG_OPENTHREAD_CLI=n
CONFIG_OPENTHREAD_NETWORK_NAME="ESPHomeHub"
CONFIG_OPENTHREAD_NETWORK_CHANNEL=25
CONFIG_OPENTHREAD_NETWORK_PANID=0x1234
CONFIG_OPENTHREAD_NETWORK_EXTPANID="dead00beef00cafe"
CONFIG_OPENTHREAD_NETWORK_MASTERKEY="00112233445566778899aabbccddeeff"
CONFIG_OPENTHREAD_NETWORK_PSKC="104810e2315100afd6bc9215a6bfac53"
```
